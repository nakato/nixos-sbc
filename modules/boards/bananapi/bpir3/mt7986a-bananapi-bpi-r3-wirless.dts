// SPDX-License-Identifier: (GPL-2.0 OR MIT)
/*
 * Copyright (C) 2021 MediaTek Inc.
 * Author: Sam.Shih <sam.shih@mediatek.com>
 */

/dts-v1/;
/plugin/;

/ {
  compatible = "bananapi,bpi-r3";

  fragment@0 {
    target = <&wifi>;
    __overlay__ {
      // Comments about this describe this as training data, not firmware.
      // So right now it exists nowhere and wifi doesn't work.
      // https://lore.kernel.org/all/a97aa98a6230e7f33a6b5f5e2c9e54ce@fw-web.de/
      // https://git.openwrt.org/?p=openwrt/openwrt.git;a=blob;f=target/linux/mediatek/dts/mt7986a-bananapi-bpi-r3.dts;h=8e47cb85790b468427051a7ac5ea6bc1f0a90775;hb=HEAD#l455
      mediatek,eeprom-data = <0x86790900 0xc4326 0x60000000 0x00 0x00 0x00 0x00 0x00
                              0x00 0x00 0x00 0x00 0x00 0x00 0x00 0x00
                              0x00 0x00 0x00 0x00 0x00 0x00 0x00 0x1000000
                              0x00 0x00 0x00 0x00 0x00 0x00 0x00 0x00
                              0x00 0x00 0x00 0x00 0x00 0x00 0x00 0x00
                              0x00 0x00 0x00 0x00 0x00 0x00 0x00 0x00
                              0x00 0x00 0x00 0x00 0x00 0x00 0x00 0x00
                              0x00 0x00 0x00 0x00 0x00 0x00 0x00 0x00
                              0x00 0x800 0x00 0x00 0x00 0x00 0x00 0x00
                              0x00 0x00 0x00 0x00 0x00 0x00 0x00 0x00
                              0x00 0x00 0x00 0x00 0x00 0x00 0x00 0x00
                              0x00 0x00 0x00 0x00 0x00 0x00 0x00 0x00
                              0x00 0x00 0x00 0x00 0x24649090 0x280000 0x5100000 0x00
                              0x00 0x00 0x00 0x00 0x00 0x00 0x00 0x00
                              0x00 0x00 0x00 0x00 0x00 0x00 0x00 0x00
                              0x00 0x00 0x00 0x00 0x00 0x00 0x00 0x00
                              0x21e00 0x21e0002 0x1e00021e 0x22800 0x2280002 0x28000228 0x00 0x00
                              0x00 0x00 0x00 0x00 0x00 0x00 0x8080 0x8080fdf7
                              0x903150d 0x80808080 0x80808080 0x5050d0d 0x1313c6c6 0xc3c3c200
                              0xc200c2 0x8182
                              0x8585c2c2 0x82828282 0x858500c2 0xc2000081 0x82858587 0x87c2c200
                              0x81818285 0x858787c2
                              0xc2000081 0x82858587 0x87c2c200 0x818285 0x858787c2 0xc2000081
                              0x82858587 0x87c4c4c2
                              0xc100c300 0xc3c3c100 0x818383c3 0xc3c3c100 0x81838300 0xc2c2c2c0
                              0x81828484 0xc3
                              0xc3c3c100 0x81838386 0x86c3c3c3 0xc1008183 0x838686c2 0xc2c2c081
                              0x82848486 0x86c3c3c3
                              0xc1008183 0x838686c3 0xc3c3c100 0x81838386 0x86c3c3c3 0xc1008183
                              0x83868622 0x28002228
                              0x222800 0x22280000 0xdddddddd 0xdddddddd 0xddbbbbbb 0xccccccdd
                              0xdddddddd 0xdddddddd
                              0xeeeeeecc 0xccccdddd 0xdddddddd 0x4a5662 0x4a 0x56620000 0x4a5662
                              0x4a
                              0x56620000 0x88888888 0x33333326 0x26262626 0x26262600 0x33333326
                              0x26262626 0x26262600
                              0x33333326 0x26262626 0x26262600 0x33333326 0x26262626 0x26262600
                              0x00 0xf0f0cc00
                              0x00 0xaaaa 0xaabbbbbb 0xcccccccc 0xccccbbbb 0xbbbbbbbb 0xbbbbbbaa
                              0xaaaabbbb
                              0xbbaaaaaa 0x999999aa 0xaaaabbbb 0xbbcccccc 0x00 0xaaaa 0xaa000000
                              0xbbbbbbbb
                              0xbbbbaaaa 0xaa999999 0xaaaaaaaa 0xaaaaaaaa 0xaaaaaaaa 0xaaaaaaaa
                              0xaaaabbbb 0xbbbbbbbb
                              0x00 0x00 0x00 0x99999999 0x9999aaaa 0xaaaaaaaa 0x999999aa
                              0xaaaaaaaa
                              0xaaaaaaaa 0xaaaaaaaa 0xaaaabbbb 0xbbbbbbbb 0x00 0xeeee 0xeeffffff
                              0xcccccccc
                              0xccccdddd 0xddbbbbbb 0xccccccbb 0xbbbbbbbb 0xbbbbbbbb 0xbbbbbbbb
                              0xbbbbcccc 0xccdddddd
                              0x516200 0x686e0051 0x6200686e 0x516200 0x686e0051 0x6200686e
                              0x516200 0x686e0051
                              0x6200686e 0x516200 0x686e0051 0x6200686e 0x516200 0x686e0051
                              0x6200686e 0x516200
                              0x686e0051 0x6200686e 0x516200 0x686e0051 0x6200686e 0x516200
                              0x686e0051 0x6200686e
                              0x516200 0x686e0051 0x6200686e 0x516200 0x686e0051 0x6200686e
                              0x516200 0x686e0051
                              0x6200686e 0x516200 0x686e0051 0x6200686e 0x516200 0x686e0051
                              0x6200686e 0x516200
                              0x686e0051 0x6200686e 0x516200 0x686e0051 0x6200686e 0x516200
                              0x686e0051 0x6200686e
                              0x88888888 0x88888888 0x88888888 0x88888888 0x88888888 0x88888888
                              0x88888888 0x88888888
                              0x00 0x00 0x00 0x00 0x00 0x00 0x00 0x00
                              0x00 0x00 0x00 0x00 0x00 0x00 0x00 0x00
                              0x00 0x00 0x00 0x00 0x00 0x00 0x00 0x00
                              0x00 0x00 0x00 0x00 0x00 0x00 0x00 0x00
                              0x00 0x00 0x00 0x00 0x00 0x00 0x00 0x00
                              0x00 0x00 0x00 0x00 0x00 0x00 0x00 0x00
                              0x00 0x00 0x00 0x00 0x00 0x00 0x00 0x00
                              0x00 0x00 0x00 0x00 0x00 0x00 0x00 0x00
                              0x00 0x00 0x00 0x00 0x00 0x00 0x00 0x00
                              0x00 0x00 0x00 0x00 0x01 0x6000100 0x1050002 0xff0300
                              0xf900fe03 0x00 0x00 0x9b 0x6e370000 0x00 0xfc0009 0xa00fe00
                              0x60700fe 0x70800 0x5000b0a 0x00 0x00 0xe2 0x96460000 0x00
                              0x400f7 0xf8000300 0xfcfe0003 0xfbfc00 0xee00e3f2 0x00 0x00 0x11
                              0xbb550000 0x00 0x600f6 0xfc000300 0xfbfe0004 0xfafe00 0xf600ecf2
                              0x00
                              0x00 0x1f 0xbf580000 0x00 0x600f5 0xf6000400 0xf8f90004 0xf7f800
                              0xf700f0f4 0x00 0x00 0x24 0xbe570000 0x00 0x800f8 0xfe000600
                              0xf8fd0007 0xf9fe00 0xf500f0f4 0x00 0x00 0x2d 0xd6610000 0x00
                              0x400f7 0xfc000500 0xf7fc0005 0xf7fc00 0xf900f5f8 0x00 0x00 0x26
                              0xd96e0000 0x00 0x400f7 0xf9000600 0xf5f70005 0xf5f800 0xf900f4f7
                              0x00
                              0x00 0x1b 0xce690000 0x00 0x300f8 0xf8000600 0xf6f60004 0xf6f700
                              0xf900f4f7 0x00 0x00 0x18 0xd8720000 0x00 0x00 0x2404002
                              0x00 0x00 0x00 0x00 0x00 0x00 0x00 0x00
                              0x00 0x00 0x00 0x00 0x00 0x00 0x00 0x00
                              0x00 0x00 0x00 0x00 0x00 0x00 0x00 0x00
                              0x00 0x00 0x00 0x00 0x00 0x00 0x00 0x00
                              0x00 0x00 0x00 0x00 0x00 0x00 0x00 0x00
                              0x00 0x00 0x00 0x00 0x00 0x00 0x00 0x00
                              0x00 0x00 0x00 0x00 0x00 0x00 0x00 0x00
                              0x00 0x00 0x00 0x00 0x00 0x00 0x00 0x00
                              0x00 0x00 0x00 0x00 0x00 0x00 0x00 0x00
                              0x00 0x00 0x00 0x00 0x00 0x00 0x00 0x00
                              0xc1c2c1c2 0x41c341c3 0x3fc13fc1 0x40c13fc2 0x3fc240c1 0x41c040c0
                              0x3fc23fc2 0x40c13fc2
                              0x3fc140c0 0x41c040c0 0x3fc33fc3 0x40c23fc2 0x3fc240c1 0x41c040c0
                              0x3fc23fc2 0x40c23fc2
                              0x3fc140c1 0x41c040c0 0x00 0x00 0x41c741c7 0xc1c7c1c7 0x00 0x00
                              0x3fc03fc0 0x3fc03fc0 0x3fc03fc0 0x3fc03fc0 0x3fc03fc0 0x3fc03fc0
                              0x3fc03fc0 0x3fc03fc0
                              0x3fc03fc0 0x3fc03fc0 0x3fc03fc0 0x3fc03fc0 0x3fc03fc0 0x3fc03fc0
                              0x3fc03fc0 0x3fc03fc0
                              0xa0ce00 0x00 0xb6840000 0x00 0x00 0x00 0x18181818 0x18181818
                              0x00 0x00 0x00 0x00 0x00 0x00 0x00 0x00
                              0x00 0x00 0x00 0x00 0x00 0x00 0x00 0x00
                              0x4b5763 0x4b 0x57630000 0x4b5763 0x4b 0x57630000 0x88888888
                              0x8474759
                              0x69780849 0x49596d7a 0x849495a 0x6d790848 0x48596c78 0x8484858
                              0x6a780848 0x48586a78
                              0x8484858 0x6c78084a 0x4a5b6d79 0x8474759 0x697a0848 0x48596b79
                              0x8484859 0x6c7a0848
                              0x48586c79 0x8484857 0x68770848 0x48576877 0x8484857 0x6a77084a
                              0x4a5a6a77 0x8464659
                              0x69790848 0x48586b79 0x8484858 0x6c7a0848 0x48596c79 0x8484857
                              0x68770848 0x48576877
                              0x8494958 0x6d7a084b 0x4b5c6c77 0x847475a 0x6a7b0849 0x495a6e7c
                              0x849495a 0x6e7c0849
                              0x495b6e7c 0x8494959 0x6a7a0849 0x49596a7a 0x84a4a5a 0x6f7d084b
                              0x4b5c6e7b 0x00
                              0x00 0x00 0x00 0x00 0x00 0x00 0x00 0x85848484
                              0xc3c4c4c5 0xc4c3c33f 0xc3c3c2c2 0xc2c2c03f 0xc3c3c3c4 0xc4c4c33f
                              0xc2c2c2c2 0xc1c3c1c1
                              0xc0c08282 0x83848686 0x88880000 0x00 0x00 0x00 0x00 0x00
                              0x00 0x00 0x00 0x00 0x00 0x00 0x00 0x00
                              0x00 0x00 0x00 0x00 0x00 0x00 0x00 0x00
                              0x00 0x00 0x00 0x00 0x00 0x00 0x00 0x00
                              0x00 0x00 0x00 0x00 0x00 0x00 0x00 0x00
                              0x00 0x00 0x00 0x00 0x00 0x00 0x00 0x00
                              0x00 0x00 0x00 0x00 0x00 0x00 0x00 0x00
                              0x00 0x00 0x00 0x00 0x00 0x00 0x00 0x00
                              0x00 0x00 0x00 0x00 0x00 0x00 0x00 0x00
                              0x00 0x00 0x00 0x00 0x00 0x00 0x00 0x00
                              0x00 0x00 0x00 0x00 0x00 0x00 0x00 0x00
                              0x00 0x00 0x00 0x00 0x00 0x00 0x00 0x00
                              0x00 0x00 0x00 0x00 0x00 0x00 0x00 0x00
                              0x00 0x00 0x00 0x00 0x00 0x00 0x00 0x00
                              0x00 0x00 0x00 0x00 0x00 0x00 0x00 0x00
                              0x00 0x00 0x00 0x00 0x00 0x00 0x00 0x00
                              0x00 0x00 0x00 0x00 0x00 0x00 0x00 0x00
                              0x00 0x00 0x00 0x00 0x00 0x00 0x00 0x00
                              0x00 0x00 0x00 0x00 0x00 0x00 0x1111 0x00
                              0x8080f703 0x10808080 0x80050d13 0x00 0x00 0x00 0x00 0x00
                              0x00 0x00 0x00 0x00 0x00 0x00 0x00 0x00
                              0x00 0x00 0x00 0x00 0x00 0x00 0x00 0x00
                              0x00 0x00 0x00 0x00 0x00 0x00 0x00 0x00
                              0x00 0x00 0x00 0x00 0x00 0x00 0x00 0x00
                              0x00 0x00 0x00 0xa4 0xce000000 0xb684 0x00 0x00
                              0x00 0x00 0x00 0x00 0x00 0x00 0x00 0x00
                              0x00 0x00 0x00 0x00 0x00 0x00 0x00 0x00
                              0x00 0x00 0x00 0x00 0x00 0x00 0x00 0x00
                              0x00 0x00 0x00 0x00 0x00 0x00 0x00 0x00
                              0x00 0x00 0x00 0x00 0x00 0x00 0x00 0x00
                              0x00 0x00 0x00 0x00 0x00 0x00 0x00 0x00
                              0x00 0x00 0x00 0x00 0x00 0x00 0x00 0x00
                              0x00 0x00 0x00 0x00 0x00 0x00 0x00 0x00
                              0x00 0x00 0x00 0x00 0x00 0x00 0x00 0x00
                              0x00 0x00 0x00 0x00 0x00 0x00 0x00 0x00
                              0x00 0x00 0x00 0x00 0x00 0x00 0x00 0x00
                              0x00 0x00 0x00 0x00 0x00 0x00 0x00 0x00
                              0x00 0x00 0x00 0x00 0x00 0x00 0x00 0x00
                              0x00 0x00 0x00 0x00 0x00 0x00 0x00 0x00>;
    };
  };
};
