// SPDX-License-Identifier: (GPL-2.0 OR MIT)

/dts-v1/;
/plugin/;

/ {
	compatible = "bananapi,bpi-r4", "mediatek,mt7988a";

	fragment@0 {
		target = <&pcie0>;
		__overlay__ {
			status = "disabled";
		};
	};

	fragment@1 {
		target = <&pcie1>;
		__overlay__ {
			status = "disabled";
		};
	};
};
